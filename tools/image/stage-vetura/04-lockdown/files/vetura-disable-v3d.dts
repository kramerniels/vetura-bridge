/dts-v1/;
/plugin/;

/{
	compatible = "brcm,bcm2835";

	fragment@0 {
		target = <&v3d>;
		__overlay__ {
			status = "disabled";
		};
	};

	fragment@1 {
		target = <&vc4>;
		__overlay__ {
			status = "disabled";
		};
	};
};
